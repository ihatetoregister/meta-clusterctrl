## conf/layer.conf
```bitbake
# We have a conf and classes directory, add to BBPATH
BBPATH .= ":${LAYERDIR}"

# We have recipes-* directories, add to BBFILES
BBFILES += "${LAYERDIR}/recipes-*/*.bb \
            ${LAYERDIR}/recipes-*/*.bbappend"

BBFILE_COLLECTIONS += "meta-clusterctrl"
BBFILE_PATTERN_meta-clusterctrl := "^${LAYERDIR}/"
BBFILE_PRIORITY_meta-clusterctrl := "5"

LAYERSERIES_COMPAT_meta-clusterctrl = "dunfell"
```
